## drivers/hid/Kconfig.rej
```kconfig
--- drivers/hid/Kconfig	2013-04-19 11:37:14.000000000 +0200
+++ drivers/hid/Kconfig	2014-08-29 08:16:13.664240000 +0200
@@ -69,7 +69,7 @@
 	Say Y here if you want to enable support for ACRUX game controllers.
 
 config HID_ACRUX_FF
-	tristate "ACRUX force feedback support"
+	bool "ACRUX force feedback support"
 	depends on HID_ACRUX
 	select INPUT_FF_MEMLESS
 	---help---
@@ -314,6 +314,7 @@
 	  - Hanvon dual touch panels
 	  - Ilitek dual touch panels
 	  - IrTouch Infrared USB panels
+	  - LG Display panels (Dell ST2220Tc)
 	  - Lumio CrystalTouch panels
 	  - MosArt dual-touch panels
 	  - PenMount dual touch panels
```

## drivers/misc/Kconfig.rej
```kconfig
--- drivers/misc/Kconfig	2013-04-19 11:37:14.000000000 +0200
+++ drivers/misc/Kconfig	2014-08-29 08:16:14.948240000 +0200
@@ -679,5 +709,6 @@
 source "drivers/misc/ti-st/Kconfig"
 source "drivers/misc/lis3lv02d/Kconfig"
 source "drivers/misc/carma/Kconfig"
+source "drivers/misc/modem_if/Kconfig"
 
 endif # MISC_DEVICES
```

## drivers/net/Kconfig.rej
```kconfig
--- drivers/net/Kconfig	2013-04-19 11:37:14.000000000 +0200
+++ drivers/net/Kconfig	2014-08-29 08:16:15.136240000 +0200
@@ -3445,7 +3445,7 @@
 config MSM_RMNET
 	tristate "MSM RMNET Virtual Network Device"
 	depends on ARCH_MSM
-	default y
+	default n
 	help
 	  Virtual ethernet interface for MSM RMNET transport.
 
```

## drivers/net/wireless/ath/Kconfig.rej
```kconfig
--- drivers/net/wireless/ath/Kconfig	2013-04-19 11:37:14.000000000 +0200
+++ drivers/net/wireless/ath/Kconfig	2014-08-29 08:16:16.856240000 +0200
@@ -25,5 +25,6 @@
 source "drivers/net/wireless/ath/ath5k/Kconfig"
 source "drivers/net/wireless/ath/ath9k/Kconfig"
 source "drivers/net/wireless/ath/carl9170/Kconfig"
+source "drivers/net/wireless/ath/ath6kl/Kconfig"
 
 endif
```

## drivers/usb/otg/Kconfig.rej
```kconfig
--- drivers/usb/otg/Kconfig	2013-04-19 11:37:14.000000000 +0200
+++ drivers/usb/otg/Kconfig	2014-08-29 08:16:34.836241000 +0200
@@ -176,6 +176,12 @@
           Enable this to support the USB OTG transceiver in AB8500 chip.
           This transceiver supports high and full speed devices plus,
           in host mode, low speed.
+	  
+config USB_RECEIVER_SENSITIVITY
+	boolean "Support USB receiver sensitivity"
+	depends on USB_ANDROID
+	help
+	  Adjust USB receiver sensitivity squelch.
 
 config FSL_USB2_OTG
 	bool "Freescale USB OTG Transceiver Driver"
```

## drivers/video/msm/Kconfig.rej
```kconfig
--- drivers/video/msm/Kconfig	2013-04-19 11:37:14.000000000 +0200
+++ drivers/video/msm/Kconfig	2014-08-29 08:16:34.996241000 +0200
@@ -512,8 +605,16 @@
 	select FB_MSM_MIPI_TRULY_VIDEO_WVGA_PT
 	select FB_MSM_MIPI_NOVATEK_VIDEO_QHD_PT
 	select FB_MSM_MIPI_NOVATEK_CMD_QHD_PT
+	select FB_MSM_MIPI_NT35510_VIDEO_HYDIS_WVGA_PT
+	select FB_MSM_MIPI_NT35510_CMD_HYDIS_WVGA_PT
+	select FB_MSM_MIPI_NT35510_CMD_BOE_WVGA_PT
+	select FB_MSM_MIPI_ORISE_VIDEO_720P_PT
+	select FB_MSM_MIPI_ORISE_CMD_720P_PT
+	select FB_MSM_MIPI_NT35516_VIDEO_QHD_PT
+	select FB_MSM_MIPI_NT35516_CMD_QHD_PT
 	select FB_MSM_MIPI_SIMULATOR_VIDEO
 	select FB_MSM_MIPI_CHIMEI_WXGA
+	select FB_MSM_MIPI_CHIMEI_WUXGA
 	---help---
 	  Support for MIPI panel auto detect
 
@@ -547,10 +648,37 @@
 	select FB_MSM_MIPI_RENESAS_CMD_FWVGA_PT
 	select FB_MSM_MIPI_NOVATEK_VIDEO_QHD_PT
 	select FB_MSM_MIPI_NOVATEK_CMD_QHD_PT
+	select FB_MSM_MIPI_NT35510_VIDEO_HYDIS_WVGA_PT
+	select FB_MSM_MIPI_NT35510_CMD_HYDIS_WVGA_PT
+	select FB_MSM_MIPI_NT35510_CMD_BOE_WVGA_PT
+	select FB_MSM_MIPI_NT35516_VIDEO_QHD_PT
+	select FM_MSM_MIPI_NT35516_CMD_QHD_PT
 	select FB_MSM_MIPI_SIMULATOR_VIDEO
 	---help---
 	  Support for LCDC + MIPI panel auto detect
 
+config FB_MSM_LVDS_MIPI_PANEL_DETECT
+	bool "LVDS + MIPI Panel Auto Detect"
+	select FB_MSM_LVDS_CHIMEI_WXGA
+	select FB_MSM_MIPI_TOSHIBA_VIDEO_WVGA_PT
+	select FB_MSM_MIPI_TOSHIBA_VIDEO_WSVGA_PT
+	select FB_MSM_MIPI_TOSHIBA_VIDEO_WUXGA
+	select FB_MSM_MIPI_RENESAS_VIDEO_FWVGA_PT
+	select FB_MSM_MIPI_RENESAS_CMD_FWVGA_PT
+	select FB_MSM_MIPI_TRULY_VIDEO_WVGA_PT
+	select FB_MSM_MIPI_NOVATEK_VIDEO_QHD_PT
+	select FB_MSM_MIPI_NOVATEK_CMD_QHD_PT
+	select FB_MSM_MIPI_NT35510_VIDEO_HYDIS_WVGA_PT
+	select FB_MSM_MIPI_NT35510_CMD_HYDIS_WVGA_PT
+	select FB_MSM_MIPI_NT35510_CMD_BOE_WVGA_PT
+	select FB_MSM_MIPI_ORISE_VIDEO_720P_PT
+	select FB_MSM_MIPI_ORISE_CMD_720P_PT
+	select FB_MSM_MIPI_SIMULATOR_VIDEO
+	select FB_MSM_MIPI_CHIMEI_WXGA
+	select FB_MSM_MIPI_CHIMEI_WUXGA
+	---help---
+	  Support for LVDS + MIPI panel auto detect
+
 config FB_MSM_MDDI_PRISM_WVGA
 	bool "MDDI Prism WVGA Panel"
 	select FB_MSM_MDDI
@@ -842,7 +990,7 @@
 
 choice
 	prompt "Default framebuffer color depth"
-	depends on FB_MSM_MDP40 || FB_MSM_MDP31
+	depends on FB_MSM_MDP40 || FB_MSM_MDP31 || FB_MSM_MDP30
 	default FB_MSM_DEFAULT_DEPTH_RGBA8888
 
 config FB_MSM_DEFAULT_DEPTH_RGB565
```
